## boards/arm/stm32/common/Kconfig
```kconfig
#
# For a description of the syntax of this configuration file,
# see the file kconfig-language.txt in the NuttX tools repository.
#

config BOARD_STM32_COMMON
       bool "Board common logic"
       default n
       ---help---
               Board common logic located in each board/common folder.

if BOARD_STM32_COMMON

if STM32_FOC

menuconfig BOARD_STM32_IHM07M1
       bool "X-NUCLEO-IHM07M1 board support"
       default n
       ---help---
         Board based on the L6230 DMOS driver.

if BOARD_STM32_IHM07M1

choice
	prompt "IHM07M1 FOC type"
	default BOARD_STM32_IHM07M1_FLOAT

config BOARD_STM32_IHM07M1_FLOAT
       bool "BOARD_STM32_IHM07M1_FLOAT"
       depends on POWER_FOC_USE_FLOAT

config BOARD_STM32_IHM07M1_FIXED16
       bool "BOARD_STM32_IHM07M1_FIXED16"
       depends on POWER_FOC_USE_FIXED16

endchoice

config BOARD_STM32_IHM07M1_VBUS
       bool "X-NUCLEO-IHM07M1 board VBUS sense"
       default n

config BOARD_STM32_IHM07M1_POT
       bool "X-NUCLEO-IHM07M1 board POT support"
       default n

endif # BOARD_STM32_IHM07M1

menuconfig BOARD_STM32_IHM08M1
       bool "X-NUCLEO-IHM08M1 board support"
       default n
       select STM32_FOC_HAS_PWM_COMPLEMENTARY
       ---help---
         Board based on the discrete L6398 gate drivers and STL220N6F7 POWER MOSFETs.

if BOARD_STM32_IHM08M1

choice
	prompt "IHM08M1 FOC type"
	default BOARD_STM32_IHM08M1_FLOAT

config BOARD_STM32_IHM08M1_FLOAT
       bool "BOARD_STM32_IHM08M1_FLOAT"
       depends on POWER_FOC_USE_FLOAT

config BOARD_STM32_IHM08M1_FIXED16
       bool "BOARD_STM32_IHM07M1_FIXED16"
       depends on POWER_FOC_USE_FIXED16

endchoice

config BOARD_STM32_IHM08M1_VBUS
       bool "X-NUCLEO-IHM08M1 board VBUS sense"
       default n

config BOARD_STM32_IHM08M1_POT
       bool "X-NUCLEO-IHM08M1 board POT support"
       default n

endif # BOARD_STM32_IHM08M1

endif # STM32_FOC

endif # BOARD_STM32_COMMON
```

## boards/arm/stm32/odrive/Kconfig
```kconfig
#
# For a description of the syntax of this configuration file,
# see the file kconfig-language.txt in the NuttX tools repository.
#

if ARCH_BOARD_ODRIVE

choice
       prompt "ODrive HW version"
       default ODRIVE_HW_36

config ODRIVE_HW_36
	bool "ODrive 3.6 version"

endchoice # ODrive HW version

choice
       prompt "ODrive voltage version"
       default ODRIVE_HW_VOLTAGE_56

config ODRIVE_HW_VOLTAGE_56
	bool "ODrive 56V version"

config ODRIVE_HW_VOLTAGE_24
	bool "ODrive 24V version"

endchoice # ODrive voltage version

config ODRIVE_FOC_CURRENT_GAIN
	int "ODrive current gain [V/V]"
	default 80
	---help---
		Possible values: 10, 20, 40, 80

if DRIVERS_FOC

config ODRIVE_FOC_FOC0
	bool "ODrive enable support for FOC device 0"
	default y

if ODRIVE_FOC_FOC0

endif # ODRIVE_FOC_FOC0

config ODRIVE_FOC_FOC1
	bool "ODrive enable support for FOC device 1"
	default y

if ODRIVE_FOC_FOC1

endif # ODRIVE_FOC_FOC1

config ODRIVE_FOC_VBUS
	bool "ODrive VBUS ADC support"
	default n

config ODRIVE_FOC_TEMP
	bool "ODrive Temperature ADC support"
	default n

endif # DRIVERS_FOC

endif # ARCH_BOARD_ODRIVE
```

## drivers/foc/Kconfig
```kconfig
menuconfig DRIVERS_FOC
  bool "FOC (Field Oriented Controller) driver support"
  select LIBDSP
  default n
  ---help---
    Enables building of the "upper-half" FOC driver.

if DRIVERS_FOC

# Support for different computations options
# We support float32 and fixed16 numeric types for now

config DRIVERS_FOC_INST
       int "FOC instances"
       default 1

config DRIVERS_FOC_PHASES
       int "FOC phases number"
       default 3

config DRIVERS_FOC_SHUNTS
       int "FOC number of shunts"
       range 1 3
       default 3
       ---help---
         Number of shunt supported (or other types of current sensors).
         Note that the upper-half logic always expect a current in a 3-phase format.
         Any current recontruction must be done on the lower-half side.

config DRIVERS_FOC_TRACE
       bool "FOC trace support"
       default n
       ---help---
         Enables FOC driver trace interface. 

endif #DRIVERS_FOC
```

## drivers/power/foc/Kconfig
```kconfig
menuconfig POWER_FOC
  bool "FOC (Field Oriented Controller) driver support"
  select LIBDSP
  default n
  ---help---
    Enables building of the "upper-half" FOC driver.

if POWER_FOC

# Support for different computations options
# We support float32 and fixed16 numeric types for now

config POWER_FOC_USE_FLOAT
       bool "FOC float support"
       default n
       ---help---
         Enables float computations support for the FOC driver.
         This is the prefered option for chips with FPU support.

config POWER_FOC_USE_FIXED16
       bool "FOC fixed16 support"
       select POWER_FOC_HAVE_FIXED
       default n
       ---help---
         Enables fixed computations support for the FOC driver.
         This is the prefered option for chips without FPU support.

config POWER_FOC_HAVE_FIXED
       bool
       default n

config POWER_FOC_FIXED16_INST
       int "FOC fixed16 instances"
       depends on POWER_FOC_USE_FIXED16
       default 1

config POWER_FOC_FLOAT_INST
       int "FOC float instances"
       depends on POWER_FOC_USE_FLOAT
       default 1

config POWER_FOC_HAVE_CORDIC
       bool "FOC lower-half CORDIC support"
       default n
       ---help---
         Enables CORDIC support in the FOC driver. This option allows the use
         of hardware acceleration for some calculations in the control algorithm.

config POWER_FOC_PHASES
       int "FOC phases number"
       default 3

config POWER_FOC_SHUNTS
       int "FOC number of shunts"
       range 1 3
       default 3
       ---help---
         Number of shunt supported (or other types of current sensors).
         Note that the upper-half logic always expect a current in a 3-phase format.
         Any current recontruction must be done on the lower-half side.

# configuration specific for FOC controller
# At the moment we support the most classic version of FOC, where
# current control is done with the PI regulator and modulation with 3-phase SVM

config POWER_FOC_CONTROL_PI
       bool "FOC default PI current controller"
       default y

config POWER_FOC_MODULATION_SVM3
       bool "FOC default 3-phase space vector modulation"
       default y

config POWER_FOC_TRACE
       bool "FOC trace support"
       default n
       ---help---
         Enables FOC driver trace interface. 

endif #POWER_FOC
```

## drivers/power/focmodel/Kconfig
```kconfig
menuconfig POWER_FOCMODEL
  bool "FOC model driver support"
  default n
  depends on POWER_FOC
  ---help---
         Enables FOC driver model support.

if POWER_FOCMODEL

config POWER_FOCMODEL_PMSM
       bool "FOC PMSM model support"
       default y

if POWER_FOCMODEL_PMSM

config POWER_FOCMODEL_PMSM_FLOAT
       bool
       default y if POWER_FOC_USE_FLOAT
       default n

config POWER_FOCMODEL_PMSM_FIXED16
       bool
       default y if POWER_FOC_USE_FIXED16
       default n

endif # POWER_FOCMODEL_PMSM

endif #POWER_FOCMODEL
```
